## tests/bsim/bluetooth/host/keys/rl_race/testcase.yaml
```yaml
tests:
  bluetooth.host.keys.rl_race:
    build_only: true
    tags:
      - bluetooth
      - bluetooth_host
    platform_allow:
      - nrf52_bsim/native
    harness: bsim
    harness_config:
      bsim_exe_name: tests_bsim_bluetooth_host_keys_rl_race_prj_conf
```

## tests/bsim/bluetooth/host/security/id_rl_settings/central/testcase.yaml
```yaml
tests:
  bluetooth.host.security.id_rl_settings.central:
    build_only: true
    tags:
      - bluetooth
    platform_allow:
      - nrf52_bsim/native
    harness: bsim
    harness_config:
      bsim_exe_name: tests_bsim_bluetooth_host_security_id_rl_settings_central_prj_conf
```
